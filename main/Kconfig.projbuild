## main/Kconfig.projbuild
```kconfig
menu "Alexa config"

menu "Wifi Configuration"

config WIFI_SSID
    string "WiFi SSID"
	default "myssid"
	help
		SSID (network name) to connect to.

config WIFI_PASSWORD
    string "WiFi Password"
	default "myssid"
	help
		WiFi password (WPA or WPA2) to use.

		Can be left blank if the network has no security set.
endmenu


choice
    prompt "Audio Output"
    default I2S
    help
        This option selects the audio output.

    config AUDIO_OUTPUT_MODE_I2S
        bool "Generic I2S"
    config AUDIO_OUTPUT_MODE_I2S_MERUS
        bool "Merus Audio I2S"
    config AUDIO_OUTPUT_MODE_DAC_BUILT_IN
        bool "Built-In DAC"
    config AUDIO_OUTPUT_MODE_PDM
        bool "PDM"
endchoice

config AUDIO_OUTPUT_MODE
    int
    default 0 if AUDIO_OUTPUT_MODE_I2S
    default 1 if AUDIO_OUTPUT_MODE_I2S_MERUS
    default 2 if AUDIO_OUTPUT_MODE_DAC_BUILT_IN
    default 3 if AUDIO_OUTPUT_MODE_PDM

choice
    prompt "API Endpoint"
    default EU
    help
        Select API endpoint URL.
        EU: European Union(Austlia/Germany/India/UK)
        US: North America(Canada/USA)
        FE: Far East(Australia/Japan/Newzealand)

    config ALEXA_ENDPOINT_EU
        bool "EU"
    config ALEXA_ENDPOINT_US
        bool "US"
    config ALEXA_ENDPOINT_FE
        bool "FE"
endchoice

config ALEXA_ENDPOINT
    string
    default "https://avs-alexa-na.amazon.com" if ALEXA_ENDPOINT_US
    default "https://avs-alexa-eu.amazon.com" if ALEXA_ENDPOINT_EU
    default "https://avs-alexa-fe.amazon.com" if ALEXA_ENDPOINT_FE


choice
    prompt "Language"
    default ALEXA_LOCALE_EN_GB
    help
        Select locale.

    config ALEXA_LOCALE_EN_US
        bool "en-US"
    config ALEXA_LOCALE_EN_GB
        bool "en-GB"
    config ALEXA_LOCALE_DE_DE
        bool "de-DE"
    config ALEXA_LOCALE_DE_AT
        bool "de-AT"
    config ALEXA_LOCALE_EN_CA
        bool "en-CA"
    config ALEXA_LOCALE_EN_IN
        bool "en-IN"
    config ALEXA_LOCALE_EN_NZ
        bool "en-NZ"
    config ALEXA_LOCALE_EN_AU
        bool "en-AU"
    config ALEXA_LOCALE_JA_JP
        bool "ja-JP"
endchoice

config ALEXA_LOCALE
    string
    default "en-US" if ALEXA_LOCALE_EN_US
    default "en-GB" if ALEXA_LOCALE_EN_GB
    default "de-DE" if ALEXA_LOCALE_DE_DE
    default "de-AT" if ALEXA_LOCALE_DE_AT
    default "en-CA" if ALEXA_LOCALE_EN_CA
    default "en-IN" if ALEXA_LOCALE_EN_IN
    default "en-NZ" if ALEXA_LOCALE_EN_NZ
    default "en-AU" if ALEXA_LOCALE_EN_AU
    default "ja-JP" if ALEXA_LOCALE_JA_JP


choice
    prompt "GPIO Pin"
    default GPIO_NUM_0
    help
        Select GPIO pin to activate voice recognition.

    config GPIO_NUM_0
        bool "GPIO 0"
    config GPIO_NUM_2
        bool "GPIO 2"
endchoice

config ALEXA_GPIO_NUM
    int
    default 0 if GPIO_NUM_0
    default 2 if GPIO_NUM_2


config ALEXA_AUTH_REFRESH_TOKEN
	string "Authentication Token"
	help
		Generate a token at https://alexa.boeckling.net/ and paste it here.

config ALEXA_SPEECH_SPEED
	string
	default "1.25"
	string "Alexa speech speed adjustment"
	help
		If quick talk, 0.5 - 1.5. default: 1.25

endmenu
```
